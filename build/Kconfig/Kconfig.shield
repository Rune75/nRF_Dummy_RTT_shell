## build/Kconfig/Kconfig.shield.defconfig
```kconfig
osource "/home/rube/work/local/nRFVScode/shell_module/boards/shields/*/Kconfig.defconfig"
osource "/home/rube/work/local/nRFVScode/ZigbeeShell/boards/shields/*/Kconfig.defconfig"
osource "/home/rube/ncs/v2.5.0/nrf/boards/shields/*/Kconfig.defconfig"
```

## build/Kconfig/Kconfig.sysbuild.modules
```kconfig
menu "nrf (/home/rube/ncs/v2.5.0/nrf)"
osource "/home/rube/ncs/v2.5.0/nrf/sysbuild/Kconfig.sysbuild"
config ZEPHYR_NRF_MODULE
	bool
	default y
endmenu
```
